## src/api/ganymede/v2/Kconfig
```kconfig
menu "Ganymede API"
    config GANYMEDE_HOST
        string "Ganymede services hostname"
        default "ganymede.davidbourgault.ca"
        help
           IP address or DNS host to connect to. This can be different from
           GANYMEDE_AUTHORITY

    config GANYMEDE_AUTHORITY
        string "Ganymede services authority"
        default "ganymede.davidbourgault.ca"
        help
          Server name expected by the nginx ingress (if any). This could differ
          from GANYMEDE_HOST when deploying the server on a local network.

    config GANYMEDE_POLL_RESPONSE_MAX_SIZE
        int "Maximum supported length for serialized PollResponses (bytes)"
        default 2048

    config GANYMEDE_LIGHT_CONFIG_MAX_SIZE
        int "Maximum supported length for serialized LightConfigs (bytes)"
        default 512

    config GRPC_PAYLOAD_BUFFER_LEN
        int "Length of buffer for payload sent to Ganymede server (bytes)"
        default 2048
        help
            Should be larger or equal to the PollResponse's maximum length.

    config GRPC_RESPONSE_BUFFER_LEN
        int "Length of buffer for payload sent to Ganymede server (bytes)"
        default 2048
endmenu
```

## src/app/Kconfig
```kconfig
menu "Ganymede App"
    config MEASUREMENTS_BUCKET_SIZE
        int "Measurements bucket capacity (items)"
        default 100
        help
           Number of measurements held in memory before they are uploaded.

    config MEASUREMENTS_ACQUISITION_INTERVAL
        int "Measurements acquisition interval (seconds)"
        default 60
        help
            How long to wait between data acquisition, in seconds
endmenu
```

## src/net/auth/Kconfig
```kconfig
menu "Authentication"

    config AUTH_AUTH0_HOSTNAME
        string "Auth0 tenant hostname"
        default "dev-ganymede.us.auth0.com"

    config AUTH_AUTH0_PORT
        int "Auth0 HTTP(S) port"
        default 443

    config AUTH_AUTH0_CLIENT_ID
        string "Auth0 Client ID"

    config AUTH_PAYLOAD_BUFFER_LENGTH
        int "Length of buffer for payload sent to authorization server (bytes)"
        default 2048
        help
            This is also used for token refresh calls, so must be able to contain it and more.

    config AUTH_RESPONSE_BUFFER_LEN
        int "Length of buffer for responses received from the authorization server (bytes)"
        default 2048
        help
            Must be able to hold the access and refresh token, and more.

    config AUTH_ACCESS_TOKEN_LEN
        int "Maximum length of the access token including the NULL terminator (bytes)"
        default 1024

    config AUTH_REFRESH_TOKEN_LEN
        int "Maximum length of the refresh token including the NULL terminator (bytes)"
        default 512

    config AUTH_REFRESH_INTERVAL
        int "How long to wait before refreshing the access token (seconds)"
        default 3600

endmenu
```

## src/net/wifi/Kconfig
```kconfig
menu "Wifi Connection"

    config WIFI_SSID
        string "WiFi SSID"

    config WIFI_PASSPRHASE
        string "WiFi passphrase"

endmenu
```
